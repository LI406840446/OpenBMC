## conf/layer.conf
```bitbake
# We have a conf and classes directory, add to BBPATH
BBPATH .= ":${LAYERDIR}"

# We have recipes-* directories, add to BBFILES
BBFILES += "${LAYERDIR}/recipes-*/*/*.bb \
            ${LAYERDIR}/recipes-*/*/*/*.bb \
            ${LAYERDIR}/recipes-*/*/*/*/*.bb \
            ${LAYERDIR}/recipes-*/*/*.bbappend \
            ${LAYERDIR}/recipes-*/*/*/*.bbappend \
            ${LAYERDIR}/recipes-*/*/*/*/*.bbappend"

BBFILE_COLLECTIONS += "meta-ricky"
BBFILE_PATTERN_meta-ricky = "^${LAYERDIR}/"
BBFILE_PRIORITY_meta-ricky = "6"

LAYERDEPENDS_meta-ricky = "core"
LAYERSERIES_COMPAT_meta-ricky = "whinlatter"
```
